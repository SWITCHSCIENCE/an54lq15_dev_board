/*
 * Copyright (c) 2024 Nordic Semiconductor ASA
 * Copyright (c) 2024 Raytac Corporation.
 *
 * SPDX-License-Identifier: Apache-2.0
 */

/dts-v1/;

#include <nordic/nrf54l15_cpuapp.dtsi>
#include "ssci_an54lq15_dev_board_cpuapp_common.dtsi"

/ {
	model = "Switch Science AN54LQ-15 Dev Board nRF54L15 Application MCU";

	chosen {
		zephyr,code-partition = &slot0_partition;
		zephyr,sram = &cpuapp_sram;
	};
};

/* Include default memory partition configuration file */
#include <vendor/nordic/nrf54l15_cpuapp_partition.dtsi>
