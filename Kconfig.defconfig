## Kconfig.ssci_an54lq15_dev_board
```kconfig
# Copyright (c) 2024 Nordic Semiconductor ASA
# Copyright (c) 2025 Raytac Corporation.
# SPDX-License-Identifier: Apache-2.0

config BOARD_SSCI_AN54LQ15_DEV_BOARD
	select SOC_NRF54L15_CPUAPP if BOARD_SSCI_AN54LQ15_DEV_BOARD_NRF54L15_CPUAPP || BOARD_SSCI_AN54LQ15_DEV_BOARD_NRF54L15_CPUAPP_NS
	select SOC_NRF54L15_CPUFLPR if BOARD_SSCI_AN54LQ15_DEV_BOARD_NRF54L15_CPUFLPR || \
					    BOARD_SSCI_AN54LQ15_DEV_BOARD_NRF54L15_CPUFLPR_XIP
```

## board.yml
```yaml
board:
  name: ssci_an54lq15_dev_board
  full_name: Switch Science AN54LQ-15 Dev Board
  vendor: ssci
  socs:
    - name: nrf54l15
      variants:
        - name: xip
          cpucluster: cpuflpr
        - name: ns
          cpucluster: cpuapp
runners:
  run_once:
    '--recover':
      - runners:
          - nrfjprog
          - nrfutil
        run: first
        groups:
          - boards:
              - ssci_an54lq15_dev_board/nrf54l15/cpuapp
              - ssci_an54lq15_dev_board/nrf54l15/cpuapp/ns
              - ssci_an54lq15_dev_board/nrf54l15/cpuflpr
              - ssci_an54lq15_dev_board/nrf54l15/cpuflpr/xip
    '--erase':
      - runners:
          - nrfjprog
          - jlink
          - nrfutil
        run: first
        groups:
          - boards:
              - ssci_an54lq15_dev_board/nrf54l15/cpuapp
              - ssci_an54lq15_dev_board/nrf54l15/cpuapp/ns
              - ssci_an54lq15_dev_board/nrf54l15/cpuflpr
              - ssci_an54lq15_dev_board/nrf54l15/cpuflpr/xip
    '--reset':
      - runners:
          - nrfjprog
          - jlink
          - nrfutil
        run: last
        groups:
          - boards:
              - ssci_an54lq15_dev_board/nrf54l15/cpuapp
              - ssci_an54lq15_dev_board/nrf54l15/cpuapp/ns
              - ssci_an54lq15_dev_board/nrf54l15/cpuflpr
              - ssci_an54lq15_dev_board/nrf54l15/cpuflpr/xip
```
